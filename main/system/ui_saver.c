/*
 * OLED screensavers (PlayStation symbols, console logos, stars, Tetris demo).
 * Local addition, not part of upstream BlueRetro.
 * SPDX-License-Identifier: Apache-2.0
 */

#include "sdkconfig.h"

#ifdef CONFIG_BLUERETRO_SYSTEM_PSX_PS2

#include <stdio.h>
#include <string.h>
#include <stdlib.h>
#include <math.h>
#include "ui_gfx.h"
#include "ui_saver.h"
#include "mx_config.h"

#define SAVER_FRAME_MS 100  /* One animation frame, driven by the ui task loop */

/* ---------------- Random (xorshift32) ---------------- */

static uint32_t rng_state = 1;

void saver_seed(uint32_t seed) {
    rng_state = seed ? seed : 1;
}

static uint32_t rnd(void) {
    rng_state ^= rng_state << 13;
    rng_state ^= rng_state >> 17;
    rng_state ^= rng_state << 5;
    return rng_state;
}

static int rnd_range(int n) {
    return (int)(rnd() % (uint32_t)n);
}

/* ---------------- PlayStation symbols ---------------- */

#define NSYM 4
static uint32_t symbols_frame;
static int symbol_order[NSYM] = { 0, 1, 2, 3 };
static int floating_phase[NSYM];

/* Symbol order requested by the UI: triangle, circle, cross, square. */
static void draw_ps_symbol(int kind, int cx, int cy, int size, int filled)
{
    int half = size / 2;
    if (kind == 0) { /* Triangle */
        int x1 = cx, y1 = cy - half;
        int x2 = cx - half, y2 = cy + half;
        int x3 = cx + half, y3 = cy + half;
        if (filled) {
            /* Correct triangular scan conversion: half-width grows linearly
             * from zero at the apex to half the requested size at the base. */
            for (int y = -half; y <= half; y++) {
                int span = ((y + half) * (size - 1)) / (2 * half);
                for (int x = -span; x <= span; x++) {
                    gfx_pixel(cx + x, cy + y, 1);
                }
            }
        }
        gfx_line(x1, y1, x2, y2, 1);
        gfx_line(x2, y2, x3, y3, 1);
        gfx_line(x3, y3, x1, y1, 1);
    } else if (kind == 1) { /* Circle */
        if (filled) gfx_fill_circle(cx, cy, half, 1);
        else gfx_circle(cx, cy, half, 1);
    } else if (kind == 2) { /* Cross */
        int thick = size / 5;
        if (thick < 3) thick = 3;
        for (int y = -half; y <= half; y++) {
            for (int x = -half; x <= half; x++) {
                int d1 = abs(x - y), d2 = abs(x + y);
                int inside = (d1 <= thick || d2 <= thick);
                if (!inside) continue;
                if (filled) {
                    gfx_pixel(cx + x, cy + y, 1);
                } else {
                    /* Outline only the boundary of the diagonal cross. */
                    int edge = 0;
                    for (int dy = -1; dy <= 1 && !edge; dy++) {
                        for (int dx = -1; dx <= 1; dx++) {
                            if (dx == 0 && dy == 0) continue;
                            int nx = x + dx, ny = y + dy;
                            int nd1 = abs(nx - ny), nd2 = abs(nx + ny);
                            if (nx < -half || nx > half || ny < -half || ny > half ||
                                !(nd1 <= thick || nd2 <= thick)) {
                                edge = 1;
                                break;
                            }
                        }
                    }
                    if (edge) gfx_pixel(cx + x, cy + y, 1);
                }
            }
        }
    } else { /* Square */
        if (filled) gfx_fill_rect(cx - half, cy - half, size, size, 1);
        else gfx_rect(cx - half, cy - half, size, size, 1);
    }
}

static void symbols_start(void)
{
    symbols_frame = 0;
    for (int i = 0; i < NSYM; i++) { symbol_order[i] = i; floating_phase[i] = i * 7; }
}

static void symbols_draw_row(int filled, int floating)
{
    static const int px[NSYM] = { 16, 48, 80, 112 };
    int cy = gfx_h() / 2;
    symbols_frame++;
    for (int i = 0; i < NSYM; i++) {
        int y = cy;
        if (floating) y += (int)(5.0 * sin((symbols_frame + floating_phase[i]) / 8.0));
        draw_ps_symbol(symbol_order[i], px[i], y, 30, filled);
    }
}

static void symbols_step(void) { symbols_draw_row(0, 0); }
static void symbols_filled_step(void) { symbols_draw_row(1, 0); }
static void symbols_floating_step(void) { symbols_draw_row(0, 1); }

/* A compact symbol-rain Tetris board: 8x8 cells, full rows disappear. */
#define SYM_CELL 8
#define SYM_COLS (GFX_W / SYM_CELL)
#define SYM_ROWS (GFX_MAX_H / SYM_CELL)
static uint8_t sym_board[SYM_ROWS][SYM_COLS];
static int sym_x, sym_y, sym_kind;
static uint32_t sym_tick;

static void symbol_tetris_start(void)
{
    memset(sym_board, 0, sizeof(sym_board));
    sym_x = SYM_COLS / 2; sym_y = 0;
    sym_kind = rnd_range(NSYM); sym_tick = 0;
}

static void symbol_tetris_lock(void)
{
    int rows = gfx_h() / SYM_CELL;
    if (sym_y >= 0 && sym_y < rows) sym_board[sym_y][sym_x] = (uint8_t)(sym_kind + 1);
    for (int r = rows - 1; r >= 0;) {
        int full = 1;
        for (int c = 0; c < SYM_COLS; c++) if (!sym_board[r][c]) { full = 0; break; }
        if (full) {
            for (int rr = r; rr > 0; rr--) memcpy(sym_board[rr], sym_board[rr - 1], SYM_COLS);
            memset(sym_board[0], 0, SYM_COLS);
        } else r--;
    }
    /* Prefer an empty column at the top so the bottom row can fill cleanly. */
    int start = rnd_range(SYM_COLS);
    int found = 0;
    for (int i = 0; i < SYM_COLS; i++) {
        int c = (start + i) % SYM_COLS;
        if (!sym_board[0][c]) { sym_x = c; found = 1; break; }
    }
    if (!found) {
        memset(sym_board, 0, sizeof(sym_board));
        sym_x = rnd_range(SYM_COLS);
    }
    sym_y = 0;
    sym_kind = rnd_range(NSYM);
}

static void symbol_tetris_step(void)
{
    int rows = gfx_h() / SYM_CELL;
    if (++sym_tick >= 3) {
        sym_tick = 0;
        if (sym_y + 1 >= rows || sym_board[sym_y + 1][sym_x]) symbol_tetris_lock();
        else sym_y++;
    }
    for (int r = 0; r < rows; r++) for (int c = 0; c < SYM_COLS; c++) {
        if (sym_board[r][c]) draw_ps_symbol((int)sym_board[r][c] - 1,
            c * SYM_CELL + SYM_CELL / 2, r * SYM_CELL + SYM_CELL / 2, 7, 1);
    }
    draw_ps_symbol(sym_kind, sym_x * SYM_CELL + SYM_CELL / 2,
                   sym_y * SYM_CELL + SYM_CELL / 2, 7, 1);
}

/* ---------------- Galaxy starfield ---------------- */

#define NSTARS 42

typedef struct {
    int x, y;
    int dx, dy;
    int phase;
    int brightness;
    int cross;
} star_t;

static star_t stars[NSTARS];
static uint32_t stars_frame;

static void stars_start(void)
{
    stars_frame = 0;

    for (int i = 0; i < NSTARS; i++) {
        stars[i].x = rnd_range(GFX_W);
        stars[i].y = rnd_range(gfx_h());

        /* Most stars drift gently; some stay nearly still. */
        stars[i].dx = rnd_range(3) - 1;
        stars[i].dy = rnd_range(3) - 1;
        if (i % 4 == 0) {
            stars[i].dx = 0;
            stars[i].dy = 0;
        }

        stars[i].phase = rnd_range(8);
        stars[i].brightness = 2 + rnd_range(7);
        stars[i].cross = (i % 7 == 0);
    }
}

static void stars_step(void)
{
    stars_frame++;

    for (int i = 0; i < NSTARS; i++) {
        star_t *s = &stars[i];

        /* Move at different angles rather than all travelling left. */
        if ((stars_frame + (uint32_t)i) % 2U == 0U) {
            s->x += s->dx;
            s->y += s->dy;
        }

        if (s->x < 0) s->x = GFX_W - 1;
        if (s->x >= GFX_W) s->x = 0;
        if (s->y < 0) s->y = gfx_h() - 1;
        if (s->y >= gfx_h()) s->y = 0;

        /* Different phase and duty cycle gives each star its own twinkle. */
        int twinkle = (int)((stars_frame + (uint32_t)s->phase) % 12U);
        if (twinkle < s->brightness) {
            gfx_pixel(s->x, s->y, 1);
        }

        /* Bright stars briefly flare into a small four-point cross. */
        if (s->cross && twinkle >= 2 && twinkle <= 5) {
            gfx_pixel(s->x - 1, s->y, 1);
            gfx_pixel(s->x + 1, s->y, 1);
            gfx_pixel(s->x, s->y - 1, 1);
            gfx_pixel(s->x, s->y + 1, 1);
        }
    }
}

/* ---------------- Console logos ---------------- */


/* Image2CPP 128x32 monochrome bitmaps: 512 bytes each. */
static const uint8_t logo_bitmap_images23[512] = {
    0x00, 0x00, 0x00, 0x00, 0x00, 0x00, 0x00, 0x00, 0x00, 0x00, 0x00, 0x00, 0x00, 0x00, 0x00, 0x00,
    0x00, 0x00, 0x00, 0x00, 0x00, 0x00, 0x00, 0x00, 0x00, 0x00, 0x00, 0x00, 0x00, 0x00, 0x00, 0x00,
    0x00, 0x00, 0x00, 0x00, 0x00, 0x00, 0x00, 0x00, 0x00, 0x00, 0x00, 0x00, 0x00, 0x00, 0x00, 0x00,
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    0x00, 0x00, 0x00, 0x00, 0x00, 0x00, 0x00, 0x00, 0x00, 0x00, 0x00, 0x00, 0x00, 0x00, 0x00, 0x00,
};

static const uint8_t logo_bitmap_images2[512] = {
    0x00, 0x00, 0x00, 0x00, 0x00, 0x00, 0x00, 0x0f, 0xf0, 0x00, 0x00, 0x00, 0x00, 0x00, 0x00, 0x00,
    0x00, 0x00, 0x00, 0x00, 0x00, 0x00, 0x00, 0x7f, 0xfe, 0x00, 0x00, 0x00, 0x00, 0x00, 0x00, 0x00,
    0x00, 0x00, 0x00, 0x00, 0x00, 0x00, 0x01, 0xe0, 0x07, 0x80, 0x00, 0x00, 0x00, 0x00, 0x00, 0x00,
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    0x00, 0x00, 0x00, 0x00, 0x00, 0x00, 0x00, 0x0f, 0xf0, 0x00, 0x00, 0x00, 0x00, 0x00, 0x00, 0x00,
};


static void draw_bitmap_128x32(const uint8_t *bitmap)
{
    int y0 = (gfx_h() - 32) / 2;

    if (y0 < 0) {
        y0 = 0;
    }
    for (int y = 0; y < 32; y++) {
        for (int x = 0; x < 128; x++) {
            uint8_t byte = bitmap[y * 16 + (x >> 3)];
            if (byte & (uint8_t)(0x80u >> (x & 7))) {
                gfx_pixel(x, y0 + y, 1);
            }
        }
    }
}


/*
 * Classic console marks, hand-rasterized as native 128x32 monochrome pixels.
 * These are bitmap assets; they are not drawn with gfx_text() or a runtime font.
 */
static const uint8_t logo_nintendo_128x32[512] = {
    0x00, 0x00, 0x00, 0x00, 0x00, 0x00, 0x00, 0x00, 0x00, 0x00, 0x00, 0x00, 0x00, 0x00, 0x00, 0x00,
    0x00, 0x00, 0x00, 0x00, 0x00, 0x00, 0x00, 0x00, 0x00, 0x00, 0x00, 0x00, 0x00, 0x00, 0x00, 0x00,
    0x00, 0x00, 0x00, 0x00, 0x00, 0x00, 0x00, 0x00, 0x00, 0x00, 0x00, 0x00, 0x00, 0x00, 0x00, 0x00,
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    0x00, 0x00, 0x00, 0x00, 0x00, 0x00, 0x00, 0x00, 0x00, 0x00, 0x00, 0x00, 0x00, 0x00, 0x00, 0x00,
};

static const uint8_t logo_sega_128x32[512] = {
    0x00, 0x00, 0x00, 0x00, 0x00, 0x00, 0x00, 0x00, 0x00, 0x00, 0x00, 0x00, 0x00, 0x00, 0x00, 0x00,
    0x00, 0x00, 0x00, 0x00, 0x00, 0x00, 0x00, 0x00, 0x00, 0x00, 0x00, 0x00, 0x00, 0x00, 0x00, 0x00,
    0x00, 0x00, 0xFF, 0xFF, 0x0F, 0xFF, 0xFF, 0x00, 0xFF, 0xFF, 0x00, 0xFF, 0xF0, 0x00, 0x00, 0x00,
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    0x00, 0x00, 0x00, 0x00, 0x00, 0x00, 0x00, 0x00, 0x00, 0x00, 0x00, 0x00, 0x00, 0x00, 0x00, 0x00,
};

static const uint8_t logo_xbox_128x32[512] = {
    0x00, 0x00, 0x00, 0x00, 0x00, 0x00, 0x00, 0x00, 0x00, 0x00, 0x00, 0x00, 0x00, 0x00, 0x00, 0x00,
    0x00, 0x00, 0x00, 0x00, 0x00, 0x00, 0x00, 0x00, 0x00, 0x00, 0x00, 0x00, 0x00, 0x00, 0x00, 0x00,
    0x00, 0x00, 0x7F, 0x80, 0x00, 0x00, 0x00, 0x00, 0x00, 0x00, 0x00, 0x00, 0x00, 0x00, 0x00, 0x00,
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    0x00, 0x00, 0x00, 0x00, 0x00, 0x00, 0x00, 0x00, 0x00, 0x00, 0x00, 0x00, 0x00, 0x00, 0x00, 0x00,
};

/* ---------------- Tetris (plays itself) ----------------
 *
 * The 10 x 20 field is drawn rotated: columns run down the screen (10 x 3 px = 30 px,
 * fits the 32 px high display) and pieces fall from left to right (20 x 3 px = 60 px).
 */

#define TW   42     /* 42 columns x 3 pixels = 126 pixels */
#define TH   10     /* 10 rows x 3 pixels = 30 pixels */
#define CELL_W 3
#define CELL_H 3
#define TX0 ((GFX_W - TW * CELL_W) / 2)
#define OVER_FRAMES 25

/* Cells (x, y) inside a 4x4 box */
static const int8_t shapes[7][4][2] = {
    { {0,1}, {1,1}, {2,1}, {3,1} },     /* I */
    { {1,1}, {2,1}, {1,2}, {2,2} },     /* O */
    { {0,1}, {1,1}, {2,1}, {1,2} },     /* T */
    { {1,1}, {2,1}, {0,2}, {1,2} },     /* S */
    { {0,1}, {1,1}, {1,2}, {2,2} },     /* Z */
    { {0,1}, {1,1}, {2,1}, {0,2} },     /* J */
    { {0,1}, {1,1}, {2,1}, {2,2} },     /* L */
};

typedef struct {
    int shape, rot, bx, by;
    int t_rot, t_bx;
} piece_t;

static uint8_t board[TH][TW];
static piece_t cur;
static uint32_t t_score, t_lines, t_games;
static int t_over;

static void piece_cells(int shape, int rot, int8_t out[4][2]) {
    for (int i = 0; i < 4; i++) {
        int x = shapes[shape][i][0];
        int y = shapes[shape][i][1];

        for (int r = 0; r < rot; r++) {
            int nx = 3 - y;
            int ny = x;

            x = nx;
            y = ny;
        }
        out[i][0] = (int8_t)x;
        out[i][1] = (int8_t)y;
    }
}

/* Rows above the field (r < 0) are allowed, so pieces can enter from the edge */
static int fits(uint8_t b[TH][TW], const int8_t cells[4][2], int bx, int by) {
    for (int i = 0; i < 4; i++) {
        int c = bx + cells[i][0];
        int r = by + cells[i][1];

        if (c < 0 || c >= TW || r >= TH) {
            return 0;
        }
        if (r >= 0 && b[r][c]) {
            return 0;
        }
    }
    return 1;
}

static int clear_lines(uint8_t b[TH][TW]) {
    int n = 0;

    for (int r = TH - 1; r >= 0;) {
        int full = 1;

        for (int c = 0; c < TW; c++) {
            if (!b[r][c]) {
                full = 0;
                break;
            }
        }
        if (full) {
            memmove(&b[1][0], &b[0][0], (size_t)r * TW);
            memset(&b[0][0], 0, TW);
            n++;
        }
        else {
            r--;
        }
    }
    return n;
}

static int eval_board(uint8_t b[TH][TW], int lines) {
    int agg = 0, holes = 0, bump = 0, prev = 0;

    for (int c = 0; c < TW; c++) {
        int first = -1;

        for (int r = 0; r < TH; r++) {
            if (b[r][c]) {
                first = r;
                break;
            }
        }
        int h = (first < 0) ? 0 : TH - first;

        if (first >= 0) {
            for (int r = first + 1; r < TH; r++) {
                if (!b[r][c]) {
                    holes++;
                }
            }
        }
        agg += h;
        if (c > 0) {
            bump += (h > prev) ? h - prev : prev - h;
        }
        prev = h;
    }
    return -510 * agg + 760 * lines - 357 * holes - 184 * bump;
}

static void choose_target(void) {
    int best = -2000000000;
    int brot = cur.rot;
    int bbx = cur.bx;
    int8_t cells[4][2];
    uint8_t tmp[TH][TW];

    for (int rot = 0; rot < 4; rot++) {
        piece_cells(cur.shape, rot, cells);
        for (int bx = -3; bx < TW; bx++) {
            int by = -3;

            if (!fits(board, cells, bx, by)) {
                continue;
            }
            while (fits(board, cells, bx, by + 1)) {
                by++;
            }
            memcpy(tmp, board, sizeof(tmp));

            int ok = 1;

            for (int i = 0; i < 4; i++) {
                int r = by + cells[i][1];
                int c = bx + cells[i][0];

                if (r < 0) {
                    ok = 0;
                    break;
                }
                tmp[r][c] = 1;
            }
            if (!ok) {
                continue;
            }

            int score = eval_board(tmp, clear_lines(tmp));

            /*
             * Prefer the centre when two landing positions have
             * the same board score. This avoids always choosing
             * the first valid position at the left edge.
             */
            int centre_distance = abs((2 * bx + 3) - (TW - 1));
            int best_distance = abs((2 * bbx + 3) - (TW - 1));

            if (score > best ||
                (score == best && centre_distance < best_distance)) {
                best = score;
                brot = rot;
                bbx = bx;
            }
        }
    }
    cur.t_rot = brot;
    cur.t_bx = bbx;
}

static void tetris_reset_board(void) {
    memset(board, 0, sizeof(board));
    t_score = 0;
    t_lines = 0;
    t_over = 0;
}

static void spawn(void) {
    int8_t cells[4][2];

    cur.shape = rnd_range(7);
    cur.rot = 0;
    cur.bx = (TW - 4) / 2;
    cur.by = -3;
    piece_cells(cur.shape, 0, cells);
    if (!fits(board, cells, cur.bx, cur.by)) {
        t_over = OVER_FRAMES;
        t_games++;
        return;
    }
    choose_target();
}

static void tetris_start(void) {
    tetris_reset_board();
    spawn();
}

static void lock_piece(void) {
    int8_t cells[4][2];

    piece_cells(cur.shape, cur.rot, cells);
    for (int i = 0; i < 4; i++) {
        int r = cur.by + cells[i][1];
        int c = cur.bx + cells[i][0];

        if (r < 0) {
            t_over = OVER_FRAMES;
            t_games++;
            return;
        }
        board[r][c] = 1;
    }

    int n = clear_lines(board);

    t_lines += (uint32_t)n;
    t_score += 10 + (uint32_t)(n * n * 100);
    spawn();
}

static void draw_cell(int c, int r) {
    int ty0 = (gfx_h() - TH * CELL_H) / 2;

    if (ty0 < 0) {
        ty0 = 0;
    }
    gfx_fill_rect(TX0 + c * CELL_W, ty0 + r * CELL_H,
                  CELL_W, CELL_H, 1);
}

static void tetris_step(void)
{
    int8_t cells[4][2];
    int h = gfx_h();

    /* Physical OLED boundary: x=0..127, y=0..gfx_h()-1. */
    for (int x = 0; x < GFX_W; x++) {
        gfx_pixel(x, 0, 1);
        gfx_pixel(x, h - 1, 1);
    }
    for (int y = 0; y < h; y++) {
        gfx_pixel(0, y, 1);
        gfx_pixel(GFX_W - 1, y, 1);
    }

    if (t_over) {
        if (--t_over == 0) {
            tetris_start();
        }
    } else {
        piece_cells(cur.shape, cur.rot, cells);

        /*
         * Reach the selected rotation and column before descending.
         * Otherwise a piece can hit the stack while still travelling
         * horizontally and never reach its selected landing position.
         */
        int aligned = (cur.rot == cur.t_rot && cur.bx == cur.t_bx);

        if (!aligned) {
            int moved = 0;

            if (cur.rot != cur.t_rot) {
                int8_t nc[4][2];
                int nr = (cur.rot + 1) & 3;

                piece_cells(cur.shape, nr, nc);
                if (fits(board, nc, cur.bx, cur.by)) {
                    cur.rot = nr;
                    moved = 1;
                }
            }

            if (!moved && cur.bx != cur.t_bx) {
                piece_cells(cur.shape, cur.rot, cells);
                int nb = cur.bx + ((cur.t_bx > cur.bx) ? 1 : -1);
                if (fits(board, cells, nb, cur.by)) {
                    cur.bx = nb;
                    moved = 1;
                }
            }

            /*
             * If the selected route is blocked, keep the game moving
             * rather than freezing the piece in place.
             */
            if (!moved) {
                piece_cells(cur.shape, cur.rot, cells);
                if (fits(board, cells, cur.bx, cur.by + 1)) {
                    cur.by++;
                } else {
                    lock_piece();
                }
            }
        } else {
            for (int step = 0; step < 3; step++) {
                piece_cells(cur.shape, cur.rot, cells);
                if (fits(board, cells, cur.bx, cur.by + 1)) {
                    cur.by++;
                } else {
                    lock_piece();
                    break;
                }
            }
        }
    }

    /* Compact 10x8 field: pieces fall from top to bottom. */
    for (int r = 0; r < TH; r++) {
        for (int c = 0; c < TW; c++) {
            if (board[r][c]) {
                draw_cell(c, r);
            }
        }
    }

    if (!t_over) {
        piece_cells(cur.shape, cur.rot, cells);
        for (int i = 0; i < 4; i++) {
            int r = cur.by + cells[i][1];
            int c = cur.bx + cells[i][0];

            if (r >= 0 && c >= 0 && c < TW && r < TH) {
                draw_cell(c, r);
            }
        }
    }
}

void saver_tetris_stats(uint32_t *games, uint32_t *total_lines) {
    if (games) {
        *games = t_games;
    }
    if (total_lines) {
        *total_lines = t_lines;
    }
}

/* ---------------- Cube (rotating wireframe, spec workbook idle_cube) ---------------- */

static uint32_t cube_t_ms;

static void cube_start(void) {
    cube_t_ms = 0;
}

static void cube_step(void) {
    const int cx = GFX_W / 2, cy = gfx_h() / 2;
    const double a = cube_t_ms / 700.0 + 0.55;
    const double scale = (gfx_h() >= 64) ? 22.0 : 20.0;
    int px[8], py[8];
    cube_t_ms += SAVER_FRAME_MS;
    for (int i = 0; i < 8; i++) {
        double x = (i & 1) ? 1.0 : -1.0;
        double y = (i & 2) ? 1.0 : -1.0;
        double z = (i & 4) ? 1.0 : -1.0;
        double xr = x * cos(a) - z * sin(a);
        double zr = x * sin(a) + z * cos(a);
        double yr = y * cos(a * 0.73) - zr * sin(a * 0.73);
        double zz = y * sin(a * 0.73) + zr * cos(a * 0.73);
        double perspective = 3.8 / (3.8 + zz * 0.35);
        px[i] = cx + (int)(xr * scale * perspective);
        py[i] = cy + (int)(yr * scale * perspective);
    }
    for (int i = 0; i < 8; i++) for (int bit = 0; bit < 3; bit++) {
        int j = i ^ (1 << bit);
        if (i < j) gfx_line(px[i], py[i], px[j], py[j], 1);
    }
}

/* ---------------- Balls (spec workbook idle_balls) ---------------- */

static int ball_x = 10, ball_y = 10, ball_dx = 2, ball_dy = 1;

static void balls_start(void) {
    ball_x = 10 + (int)(rnd() % 40U);
    ball_y = 4 + (int)(rnd() % 8U);
    ball_dx = 2;
    ball_dy = 1;
}

static void balls_step(void) {
    int h = gfx_h();

    gfx_fill_rect(ball_x, ball_y, 5, 5, 1);
    ball_x += ball_dx;
    ball_y += ball_dy;
    if (ball_x < 0 || ball_x > GFX_W - 6) {
        ball_dx = -ball_dx;
        ball_x += 2 * ball_dx;
    }
    if (ball_y < 0 || ball_y > h - 6) {
        ball_dy = -ball_dy;
        ball_y += 2 * ball_dy;
    }
}

/* ---------------- Pong (spec workbook idle_pong) ---------------- */

static int pong_bx = 64, pong_by = 16, pong_bdx = 3, pong_bdy = 2;
static uint32_t pong_t_ms;

static void pong_start(void) {
    pong_bx = GFX_W / 2;
    pong_by = gfx_h() / 2;
    pong_bdx = 3;
    pong_bdy = 2;
    pong_t_ms = 0;
}

static void pong_step(void) {
    int h = gfx_h();
    int amp = h / 2 - 9;
    int p1, p2;

    if (amp < 2) {
        amp = 2;
    }

    pong_t_ms += SAVER_FRAME_MS;

    p1 = h / 2 + (int)(amp * sin(pong_t_ms / 400.0));
    p2 = h / 2 + (int)(amp * cos(pong_t_ms / 500.0));
    gfx_fill_rect(2, p1 - 7, 3, 14, 1);
    gfx_fill_rect(GFX_W - 5, p2 - 7, 3, 14, 1);
    gfx_fill_rect(pong_bx, pong_by, 3, 3, 1);
    pong_bx += pong_bdx;
    pong_by += pong_bdy;
    if (pong_by <= 0 || pong_by >= h - 4) {
        pong_bdy = -pong_bdy;
        pong_by += 2 * pong_bdy;
    }
    if (pong_bx <= 6 || pong_bx >= GFX_W - 9) {
        pong_bdx = -pong_bdx;
        pong_bx += 2 * pong_bdx;
    }
}

/* ---------------- Clocks (MX time slot) ---------------- */

/* Analog and flip clock slots are retained only for MX configuration ABI compatibility. */

static void clock_rect_start(void) {}

static void clock_rect_step(void) {
    /* Big 7-segment clock filling the full panel width */
    const struct mx_time_cfg *t = mx_cfg_time();
    int h = gfx_h();
    int ck_h = (h >= 48) ? 34 : h - 6;
    int ty = (h - ck_h) / 2;
    char b[24];

    gfx_big_hhmmss(0, ty, GFX_W, ck_h, t->hour, t->minute, t->second);
    if (h >= 48) {
        snprintf(b, sizeof(b), "%02u-%02u-%04u", t->day, t->month, t->year);
        gfx_text((GFX_W - (int)strlen(b) * 6) / 2, ty + ck_h + 6, b);
    }
}

/* ---------------- Logo savers ---------------- */

static void logo_ps_start(void) {}

static void logo_ps_step(void) {
    draw_bitmap_128x32(logo_bitmap_images23);
}

static void logo_playstation_start(void) {}

static void logo_playstation_step(void) {
    draw_bitmap_128x32(logo_bitmap_images2);
}

/* Rotate the three classic console bitmap marks every 12 seconds. */
#define CONSOLE_LOGO_HOLD_FRAMES 120U
static uint32_t console_logo_frame;

static void console_logos_start(void)
{
    console_logo_frame = 0;
}

static void console_logos_step(void)
{
    unsigned index = (console_logo_frame / CONSOLE_LOGO_HOLD_FRAMES) % 3U;
    switch (index) {
        case 0: draw_bitmap_128x32(logo_nintendo_128x32); break;
        case 1: draw_bitmap_128x32(logo_sega_128x32); break;
        default: draw_bitmap_128x32(logo_xbox_128x32); break;
    }
    console_logo_frame++;
}

/* ---------------- Public API ---------------- */

void saver_start(saver_id_t id) {
    switch (id) {
        case SAVER_CUBE:            cube_start(); break;
        case SAVER_STARS:           stars_start(); break;
        case SAVER_TETRIS:          tetris_start(); break;
        case SAVER_SYMBOLS:         symbols_start(); break;
        case SAVER_BALLS:           balls_start(); break;
        case SAVER_PONG:            pong_start(); break;
        case SAVER_CLOCK_ANALOG:    /* retired legacy slot */ break;
        case SAVER_CLOCK_FLIP:      /* retired duplicate clock */ break;
        case SAVER_CLOCK_RECT:      clock_rect_start(); break;
        case SAVER_LOGO_PS:         logo_ps_start(); break;
        case SAVER_LOGO_PLAYSTATION: logo_playstation_start(); break;
        case SAVER_LOGOS:           console_logos_start(); break;
        case SAVER_SYMBOLS_FILLED:  symbols_start(); break;
        case SAVER_SYMBOLS_FLOATING: symbols_start(); break;
        case SAVER_SYMBOL_TETRIS:   symbol_tetris_start(); break;
        default: break;
    }
}

void saver_step(saver_id_t id) {
    gfx_clear();
    gfx_set_offset(0, 0);
    switch (id) {
        case SAVER_CUBE:            cube_step(); break;
        case SAVER_STARS:           stars_step(); break;
        case SAVER_TETRIS:          tetris_step(); break;
        case SAVER_SYMBOLS:         symbols_step(); break;
        case SAVER_BALLS:           balls_step(); break;
        case SAVER_PONG:            pong_step(); break;
        case SAVER_CLOCK_ANALOG:    /* retired legacy slot */ break;
        case SAVER_CLOCK_FLIP:      /* retired duplicate clock */ break;
        case SAVER_CLOCK_RECT:      clock_rect_step(); break;
        case SAVER_LOGO_PS:         logo_ps_step(); break;
        case SAVER_LOGO_PLAYSTATION: logo_playstation_step(); break;
        case SAVER_LOGOS:           console_logos_step(); break;
        case SAVER_SYMBOLS_FILLED:  symbols_filled_step(); break;
        case SAVER_SYMBOLS_FLOATING: symbols_floating_step(); break;
        case SAVER_SYMBOL_TETRIS:   symbol_tetris_step(); break;
        default: break;
    }
}

const char *saver_name(saver_id_t id) {
    switch (id) {
        case SAVER_CUBE:            return "CUBE";
        case SAVER_STARS:           return "STARS";
        case SAVER_TETRIS:          return "TETRIS";
        case SAVER_SYMBOLS:         return "SYMBOLS";
        case SAVER_BALLS:           return "BALLS";
        case SAVER_PONG:            return "PONG";
        case SAVER_CLOCK_ANALOG:    return "DISABLED";
        case SAVER_CLOCK_FLIP:      return "DISABLED";
        case SAVER_CLOCK_RECT:      return "CLOCK";
        case SAVER_LOGO_PS:         return "LOGO PS";
        case SAVER_LOGO_PLAYSTATION: return "LOGO PLAYSTATION";
        case SAVER_LOGOS:           return "CONSOLE LOGOS";
        case SAVER_SYMBOLS_FILLED:  return "SYMBOLS FILLED";
        case SAVER_SYMBOLS_FLOATING: return "SYMBOLS FLOAT";
        case SAVER_SYMBOL_TETRIS:   return "SYMBOL TETRIS";
        default:                    return "?";
    }
}

#endif /* CONFIG_BLUERETRO_SYSTEM_PSX_PS2 */
